/*
  AstroCYD MS · AB MakerIDE / MS Robotika
  Asistente de astronomía y astrofotografía para la CYD ESP32-2432S028R:
    CIELO     mapa del cielo en directo (5044 estrellas, constelaciones, planetas, Luna y Sol);
              toca un objeto para ver su ficha; -1 h / +1 h para ver cómo se mueve.
    LUNA      fase dibujada, salida y puesta, distancia, próxima luna nueva y llena.
    NOCHE     nota de 0 a 10 para esta noche: nubes hora a hora (Open-Meteo), Luna,
              noche astronómica, contaminación lumínica y si se ve el centro de la Vía Láctea.
    AURORA    índice Kp y previsión a 3 días (NOAA SWPC) y el Kp que hace falta en tu zona.
    TU CIELO  cuántas estrellas ves con tu contaminación lumínica frente a un cielo oscuro.
    FOTO      disparador por Bluetooth para el móvil (como un botón de «subir volumen»).
  Botón ROJO: modo visión nocturna (todo en rojo y brillo bajo). Mantén pulsado 3 s para
  los ajustes: la placa crea la red "AstroCYD-MS" con un QR y una página para el móvil.

  Ubicación: la que pegues en los ajustes (coordenadas o un enlace de Google Maps); si no,
  la de Radar Aviones MS; si no, una aproximada por internet (ipapi.co). Solo se guarda en la
  placa y la pantalla nunca la muestra.

  Datos: cálculos propios (método de Paul Schlyter), estrellas de d3-celestial (BSD-3),
  nubes de Open-Meteo (CC BY 4.0, uso no comercial), Kp de NOAA SWPC (dominio público).
  HTTPS validado con las raíces de certs.h. Placa: "ESP32 Dev Module" (esp32 3.x) con
  esquema de particiones "Huge APP". Librerías: Adafruit GFX, Adafruit ILI9341,
  XPT2046_Touchscreen, ArduinoJson 7, NimBLE-Arduino 2.x. Licencia MIT.
*/
#include <Arduino.h>
#include <SPI.h>
#include <WiFi.h>
#include <WiFiClientSecure.h>
#include <HTTPClient.h>
#include <WebServer.h>
#include <DNSServer.h>
#include <Preferences.h>
#include <ArduinoJson.h>
#include <Adafruit_GFX.h>
#include <Adafruit_ILI9341.h>
#include <XPT2046_Touchscreen.h>
#include <NimBLEDevice.h>
#include <NimBLEHIDDevice.h>
#include <qrcode.h>
// ===== inicio astro.h =====
// Cálculos astronómicos de AstroCYD MS (método de Paul Schlyter, "How to compute planetary
// positions"): Sol, Luna y planetas con error de 1-2 minutos de arco, de sobra para un mapa
// de 320x240. Ángulos en grados. d = días desde 2000 ene 0.0 TU.
// shortcut: las estrellas van en J2000 y los planetas en el equinoccio de la fecha (0,4° en 2026,
// medio píxel en el mapa); si se quiere más precisión, precesar las estrellas al arrancar.
#include <math.h>
#include <time.h>

namespace astro {

constexpr double RAD = M_PI / 180.0;
inline double rev(double x) { x = fmod(x, 360.0); return x < 0 ? x + 360 : x; }
inline double sind(double x) { return sin(x * RAD); }
inline double cosd(double x) { return cos(x * RAD); }
inline double atan2d(double y, double x) { return atan2(y, x) / RAD; }
inline double asind(double x) { return asin(fmax(-1.0, fmin(1.0, x))) / RAD; }

inline double dayNumber(time_t utc) { return utc / 86400.0 - 10956.0; }  // 2000-01-00 00:00 = 946598400 s
inline double obliquity(double d) { return 23.4393 - 3.563e-7 * d; }

struct Eq { double ra, dec, dist; };      // dist en UA (Luna: radios terrestres)
struct Hor { double alt, az; };           // az desde el norte hacia el este

inline void eclToEq(double lon, double lat, double r, double d, Eq& e) {
  double x = r * cosd(lon) * cosd(lat), y = r * sind(lon) * cosd(lat), z = r * sind(lat);
  double ecl = obliquity(d);
  double ye = y * cosd(ecl) - z * sind(ecl), ze = y * sind(ecl) + z * cosd(ecl);
  e.ra = rev(atan2d(ye, x));
  e.dec = atan2d(ze, sqrt(x * x + ye * ye));
  e.dist = r;
}

inline double eccAnomaly(double M, double e) {
  double E = M + e / RAD * sind(M) * (1 + e * cosd(M));
  for (int i = 0; i < 8; i++) {
    double dE = (E - e / RAD * sind(E) - M) / (1 - e * cosd(E));
    E -= dE;
    if (fabs(dE) < 1e-6) break;
  }
  return E;
}

// Sol: longitud eclíptica y distancia (UA). Ls = longitud media, para el tiempo sidéreo.
struct SunState { double lon, r, Ls, M; };
inline SunState sunState(double d) {
  double w = 282.9404 + 4.70935e-5 * d, e = 0.016709 - 1.151e-9 * d, M = rev(356.0470 + 0.9856002585 * d);
  double E = eccAnomaly(M, e);
  double xv = cosd(E) - e, yv = sqrt(1 - e * e) * sind(E);
  return {rev(atan2d(yv, xv) + w), sqrt(xv * xv + yv * yv), rev(w + M), M};
}
inline Eq sun(double d) { SunState s = sunState(d); Eq e; eclToEq(s.lon, 0, s.r, d, e); return e; }

// Tiempo sidéreo de Greenwich en grados.
inline double gmst(double d) { double ut = fmod(d + 10956.0, 1.0) * 24; if (ut < 0) ut += 24; return rev(sunState(d).Ls + 180 + ut * 15); }

inline Hor toHorizon(double ra, double dec, double lst, double lat) {
  double ha = lst - ra;
  double x = cosd(ha) * cosd(dec), y = sind(ha) * cosd(dec), z = sind(dec);
  double xh = x * sind(lat) - z * cosd(lat), zh = x * cosd(lat) + z * sind(lat);
  return {asind(zh), rev(atan2d(y, xh) + 180)};
}

// Luna geocéntrica con las perturbaciones principales; lon/lat eclípticas de salida.
struct MoonState { Eq eq; double lon, lat; };
inline MoonState moon(double d) {
  double N = rev(125.1228 - 0.0529538083 * d), i = 5.1454, w = rev(318.0634 + 0.1643573223 * d);
  double a = 60.2666, e = 0.054900, M = rev(115.3654 + 13.0649929509 * d);
  double E = eccAnomaly(M, e);
  double xv = a * (cosd(E) - e), yv = a * sqrt(1 - e * e) * sind(E);
  double v = atan2d(yv, xv), r = sqrt(xv * xv + yv * yv);
  double xh = r * (cosd(N) * cosd(v + w) - sind(N) * sind(v + w) * cosd(i));
  double yh = r * (sind(N) * cosd(v + w) + cosd(N) * sind(v + w) * cosd(i));
  double zh = r * sind(v + w) * sind(i);
  double lon = atan2d(yh, xh), lat = atan2d(zh, sqrt(xh * xh + yh * yh));
  SunState s = sunState(d);
  double Ms = s.M, Mm = M, Lm = rev(N + w + M), D = Lm - s.Ls, F = Lm - N;
  lon += -1.274 * sind(Mm - 2 * D) + 0.658 * sind(2 * D) - 0.186 * sind(Ms) - 0.059 * sind(2 * Mm - 2 * D)
         - 0.057 * sind(Mm - 2 * D + Ms) + 0.053 * sind(Mm + 2 * D) + 0.046 * sind(2 * D - Ms) + 0.041 * sind(Mm - Ms)
         - 0.035 * sind(D) - 0.031 * sind(Mm + Ms) - 0.015 * sind(2 * F - 2 * D) + 0.011 * sind(Mm - 4 * D);
  lat += -0.173 * sind(F - 2 * D) - 0.055 * sind(Mm - F - 2 * D) - 0.046 * sind(Mm + F - 2 * D)
         + 0.033 * sind(F + 2 * D) + 0.017 * sind(2 * Mm + F);
  r += -0.58 * cosd(Mm - 2 * D) - 0.46 * cosd(2 * D);
  MoonState m;
  m.lon = rev(lon); m.lat = lat;
  eclToEq(m.lon, lat, r, d, m.eq);
  return m;
}
// Fracción iluminada (0-1) y edad en grados (0 nueva, 90 cuarto creciente, 180 llena).
inline void moonPhase(double d, double& illum, double& age) {
  MoonState m = moon(d);
  SunState s = sunState(d);
  age = rev(m.lon - s.lon);
  double elong = acos(cosd(m.lon - s.lon) * cosd(m.lat)) / RAD;
  illum = (1 - cosd(elong)) / 2;
}
// Altura topocéntrica de la Luna (paralaje de hasta 1°).
inline Hor moonHorizon(double d, double lst, double lat) {
  MoonState m = moon(d);
  Hor h = toHorizon(m.eq.ra, m.eq.dec, lst, lat);
  h.alt -= asind(1 / m.eq.dist) * cosd(h.alt);
  return h;
}

// Planetas: 0 Mercurio, 1 Venus, 2 Marte, 3 Júpiter, 4 Saturno.
struct Planet { Eq eq; double mag; };
inline Planet planet(int p, double d) {
  static const double EL[5][12] = {
    // N, dN, i, di, w, dw, a, e, de, M, dM, (sin uso)
    {48.3313, 3.24587e-5, 7.0047, 5.00e-8, 29.1241, 1.01444e-5, 0.387098, 0.205635, 5.59e-10, 168.6562, 4.0923344368, 0},
    {76.6799, 2.46590e-5, 3.3946, 2.75e-8, 54.8910, 1.38374e-5, 0.723330, 0.006773, -1.302e-9, 48.0052, 1.6021302244, 0},
    {49.5574, 2.11081e-5, 1.8497, -1.78e-8, 286.5016, 2.92961e-5, 1.523688, 0.093405, 2.516e-9, 18.6021, 0.5240207766, 0},
    {100.4542, 2.76854e-5, 1.3030, -1.557e-7, 273.8777, 1.64505e-5, 5.20256, 0.048498, 4.469e-9, 19.8950, 0.0830853001, 0},
    {113.6634, 2.38980e-5, 2.4886, -1.081e-7, 339.3939, 2.97661e-5, 9.55475, 0.055546, -9.499e-9, 316.9670, 0.0334442282, 0}};
  const double* k = EL[p];
  double N = k[0] + k[1] * d, i = k[2] + k[3] * d, w = k[4] + k[5] * d, a = k[6], e = k[7] + k[8] * d, M = rev(k[9] + k[10] * d);
  double E = eccAnomaly(M, e);
  double xv = a * (cosd(E) - e), yv = a * sqrt(1 - e * e) * sind(E);
  double v = atan2d(yv, xv), r = sqrt(xv * xv + yv * yv);
  double xh = r * (cosd(N) * cosd(v + w) - sind(N) * sind(v + w) * cosd(i));
  double yh = r * (sind(N) * cosd(v + w) + cosd(N) * sind(v + w) * cosd(i));
  double zh = r * sind(v + w) * sind(i);
  double lon = atan2d(yh, xh), lat = atan2d(zh, sqrt(xh * xh + yh * yh));
  if (p >= 3) {  // perturbaciones mutuas de Júpiter y Saturno
    double Mj = rev(19.8950 + 0.0830853001 * d), Ms = rev(316.9670 + 0.0334442282 * d);
    if (p == 3)
      lon += -0.332 * sind(2 * Mj - 5 * Ms - 67.6) - 0.056 * sind(2 * Mj - 2 * Ms + 21) + 0.042 * sind(3 * Mj - 5 * Ms + 21)
             - 0.036 * sind(Mj - 2 * Ms) + 0.022 * cosd(Mj - Ms) + 0.023 * sind(2 * Mj - 3 * Ms + 52) - 0.016 * sind(Mj - 5 * Ms - 69);
    else {
      lon += 0.812 * sind(2 * Mj - 5 * Ms - 67.6) - 0.229 * cosd(2 * Mj - 4 * Ms - 2) + 0.119 * sind(Mj - 2 * Ms - 3)
             + 0.046 * sind(2 * Mj - 6 * Ms - 69) + 0.014 * sind(Mj - 3 * Ms + 32);
      lat += -0.020 * cosd(2 * Mj - 4 * Ms - 2) + 0.018 * sind(2 * Mj - 6 * Ms - 49);
    }
  }
  xh = r * cosd(lon) * cosd(lat); yh = r * sind(lon) * cosd(lat); zh = r * sind(lat);
  SunState s = sunState(d);
  double xg = xh + s.r * cosd(s.lon), yg = yh + s.r * sind(s.lon), zg = zh;
  double R = sqrt(xg * xg + yg * yg + zg * zg);
  Planet out;
  eclToEq(atan2d(yg, xg), atan2d(zg, sqrt(xg * xg + yg * yg)), R, d, out.eq);
  double FV = acos(fmax(-1.0, fmin(1.0, (r * r + R * R - s.r * s.r) / (2 * r * R)))) / RAD;
  static const double M0[5] = {-0.36, -4.34, -1.51, -9.25, -9.0}, K1[5] = {0.027, 0.013, 0.016, 0.014, 0.044};
  out.mag = M0[p] + 5 * log10(r * R) + K1[p] * FV;
  if (p == 0) out.mag += 2.2e-13 * pow(FV, 6);
  if (p == 1) out.mag += 4.2e-7 * FV * FV * FV;
  return out;
}

// Polo norte geomagnético (modelo IGRF de dipolo, época 2025, aprox.).
inline double geomagLat(double lat, double lon) {
  const double PLAT = 80.8, PLON = -72.6;
  return asind(sind(lat) * sind(PLAT) + cosd(lat) * cosd(PLAT) * cosd(lon - PLON));
}
// Kp aproximado para ver auroras sobre el horizonte norte en esa latitud geomagnética.
// Ajuste empírico: Kp 9 llega a ~43° (mayo 2024 en España), Kp 5 a ~53°.
inline double kpNeeded(double gmLat) { return (66.5 - gmLat) / 2.6; }

// Magnitud límite a simple vista por clase de Bortle (1 a 9).
inline float limitingMag(int bortle) {
  static const float L[10] = {6.0f, 7.6f, 7.1f, 6.6f, 6.1f, 5.6f, 5.1f, 4.6f, 4.1f, 3.8f};
  return L[bortle < 1 ? 1 : bortle > 9 ? 9 : bortle];
}

}  // namespace astro
// ===== fin astro.h =====
// ===== inicio stars.h =====
// Generado por tools/generar_datos.py con datos de d3-celestial (BSD-3, (c) 2015 Olaf Frohn).
// Coordenadas J2000: ra en 1/65536 de vuelta, dec en centésimas de grado, mag y B-V por 10.
#include <stdint.h>
struct Star { uint16_t ra; int16_t dec; int8_t mag10, bv10; uint8_t con, name; };
struct CPoint { uint16_t ra; int16_t dec; };
struct CPoly { uint8_t con; uint16_t first; uint8_t count; };
struct CLabel { uint16_t ra; int16_t dec; uint8_t rank; };
constexpr int STAR_COUNT = 5044, CPOINT_COUNT = 893, CPOLY_COUNT = 150, CON_COUNT = 89;
const Star STARS[] PROGMEM = {
  {18439,-1672,-14,0,13,0},{17474,-5270,-6,2,16,1},{38942,1918,0,12,8,2},{40032,-6083,0,7,18,3},{50833,3878,0,0,51,4},{14413,4600,1,8,7,5},
  {14315,-820,2,0,59,6},{20903,522,4,4,14,7},{4447,-5724,4,-2,35,8},{16164,741,4,15,59,9},{38403,-6037,6,-2,18,10},{54194,887,8,2,4,11},
  {33979,-6310,8,-2,29,12},{12557,1651,9,15,78,13},{36645,-1116,10,-2,86,14},{45029,-2643,11,19,72,15},{21177,2803,12,10,37,16},{62698,-2962,12,1,66,17},
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  {58129,5580,60,14,255,255},{59450,-928,60,16,15,255},{60081,672,60,-1,61,255},{61339,3184,60,14,255,255},
};
const CPoint CPOINTS[] PROGMEM = {
  {5639,4233},{3174,3562},{1790,3086},{382,2909},{2604,2342},{2154,2427},{1755,2931},{1790,3086},{1678,3372},{64541,4327},
  {62893,4233},{64541,4327},{64644,4433},{64515,4646},{3174,3562},{2583,3850},{2267,4108},{3163,4724},{4460,4863},{64644,4433},
  {64900,4642},{25907,-3595},{28542,-3107},{29888,-3714},{40408,-7904},{44617,-7870},{45651,-7752},{45213,-7890},{56783,-950},{57010,-898},
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  {54316,2408},{54663,2775},{55331,2781},
};
const CPoly CPOLYS[] PROGMEM = {
  {0,0,4},{0,4,7},{0,11,3},{0,14,5},{0,19,2},{1,21,3},{2,24,4},{3,28,10},{3,38,2},{3,40,2},
  {3,42,2},{3,44,3},{4,47,10},{5,57,7},{6,64,4},{7,68,11},{8,79,10},{8,89,5},{9,94,4},{10,98,6},
  {10,104,3},{11,107,4},{11,111,2},{12,113,2},{13,115,7},{13,122,2},{13,124,5},{14,129,2},{15,131,11},{16,142,13},
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  {83,839,5},{83,844,4},{83,848,2},{84,850,8},{85,858,8},{86,866,8},{86,874,3},{86,877,4},{87,881,7},{88,888,5},
};
const CLabel CLABELS[] PROGMEM = {
  {1820,3700,1},{28054,-3248,3},{44055,-7500,3},{60985,-1100,2},{53704,341,1},{47445,-5659,3},{7198,2079,1},{16566,4200,1},{40050,3100,1},{12847,-3788,3},
  {14564,7000,2},{23618,1981,2},{35815,4010,2},{18648,-2214,1},{20897,643,2},{57477,-1802,2},{23743,-6322,1},{3602,6218,1},{35681,-4700,1},{62259,7300,2},
  {4551,-700,1},{29127,-7900,3},{39801,-6303,3},{16009,-3509,3},{34919,2331,3},{50917,-4115,3},{43262,3262,2},{33975,-1844,3},{31118,-1593,3},{33996,-6019,2},
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  {5965,3148,3},{43916,-6539,2},{64928,-6583,3},{30891,5072,1},{40050,7800,2},{26152,-4717,2},{36773,-400,1},{21287,-6980,3},{55245,2444,3},
};
const char* const CON_NAMES[] = {
  "Andrómeda","MáquinaNeumática","AvedelParaíso","Acuario","Águila","Altar",
  "Carnero","Cochero","Boyero","Cincel","Jirafa","Cangrejo",
  "Lebreles","PerroMayor","PerroMenor","Capricornio","Carina","Casiopea",
  "Centauro","Cefeo","Ballena","Camaleón","Compás","Paloma",
  "PelodeBerenice","CoronaAustral","CoronaBoreal","Cuervo","Copa","CruzdelSur",
  "Cisne","Delfín","Pezdorado","Dragón","Caballito","Erídano",
  "Horno","Gemelos","Grulla","Hércules","Reloj","Hidra",
  "HidraMacho","Indio","Lagarto","León","LeónMenor","Conejo",
  "Balanza","Lobo","Lince","Lira","Mesa","Microscopio",
  "Unicornio","Mosca","Escuadra","Bastón","Ofiuco","Orión",
  "Pavo","Pegaso","Perseo","Fénix","PaletadelPintor","Peces",
  "PezAustral","Popa","Brújula","Retículo","Flecha","Sagitario",
  "Escorpión","Escultor","Escudo","Serpiente","Serpiente","Sextante",
  "Toro","Telescopio","Triángulo","TriánguloAustral","Tucán","OsaMayor",
  "OsaMenor","Vela","Virgen","PezVolador","Zorro",
};
const char* const STAR_NAMES[] = {
  "Sirio","Canopus","Arturo","Rigil Kentaurus","Vega","Capella",
  "Rigel","Proción","Achernar","Betelgeuse","Hadar","Altair",
  "Acrux","Aldebarán","Spica","Antares","Pollux","Fomalhaut",
  "Mimosa","Deneb","Toliman","Régulo","Adhara","Castor",
  "Gacrux","Shaula","Bellatrix","Elnath","Miaplacidus","Alnilam",
  "Alnair","Alnitak","Regor","Alioth","Mirfak","Kaus Australis",
  "Dubhe","Wezen","Alkaid","Avior","Sargas","Menkalinan",
  "Atria","Alhena","Alsephina","Peacock","Estrella Polar","Murzim",
  "Alphard","Hamal","Algieba","Diphda","Nunki","Menkent",
  "Alpheratz","Mirach","Saiph","Kochab","Tiaki","Rasalhague",
  "Algol","Almach","Denébola","Navi","Muhlifain","Naos",
  "Aspidiske","Alphecca","Suhail","Mizar","Sadr","Shedar",
  "Eltanin","Mintaka","Caph","Dschubba","Larawag","Men",
  "Merak","Izar","Enif","Mula","Ankaa","Phecda",
  "Sabik","Scheat","Aludra","Alderamín","Markeb","Aljanah",
  "Markab","Menkar","Saik","Alnair","Zosma","Acrab",
  "Arneb","Gienah","Ascella","Zubeneschamali","Unukalhai","Sheratan",
  "Phact","Mahasim","Kraz","Ksora","Muphrid","KeKouan",
  "Hassaleh","Lesath","Kaus Media","Tarazed","Yed Prior","Athebyne",
  "Porrima","Hatysa","Zubenelgenubi","Cebalrai","Cursa","Kornephoros",
  "Rasalgethi","Imai","Rastaban","Nihal","Rutilicus","Paikauhale",
  "Kaus Borealis","Algenib","Tureis","Atik","Choo","Alcíone",
  "Vindemiatrix","Deneb Algedi","Fawaris","Tejat","Acamar","Albaldah",
  "Gomeisa","Cor Caroli","Fang","Alniyat","Sadalsuud","Matar",
  "Algorab","Sadalmelik","Zaurak","Tianguan","Algenubi","Alnasl",
  "Girtab","Okab","Mizan","Pherkad","Xamidimura","Aldhanab",
};
// ===== fin stars.h =====
// ===== inicio certs.h =====
// Raíces públicas (no son claves privadas) del almacén de Mozilla, para validar HTTPS:
// Open-Meteo (ISRG), NOAA SWPC (Amazon/Starfield), ipapi.co y Google Maps (GTS).
const char ROOT_CA[] = R"PEM(-----BEGIN CERTIFICATE-----
MIIFazCCA1OgAwIBAgIRAIIQz7DSQONZRGPgu2OCiwAwDQYJKoZIhvcNAQELBQAw
TzELMAkGA1UEBhMCVVMxKTAnBgNVBAoTIEludGVybmV0IFNlY3VyaXR5IFJlc2Vh
cmNoIEdyb3VwMRUwEwYDVQQDEwxJU1JHIFJvb3QgWDEwHhcNMTUwNjA0MTEwNDM4
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emyPxgcYxn/eR44/KJ4EBs+lVDR3veyJm+kXQ99b21/+jh5Xos1AnX5iItreGCc=
-----END CERTIFICATE-----
-----BEGIN CERTIFICATE-----
MIICGzCCAaGgAwIBAgIQQdKd0XLq7qeAwSxs6S+HUjAKBggqhkjOPQQDAzBPMQsw
CQYDVQQGEwJVUzEpMCcGA1UEChMgSW50ZXJuZXQgU2VjdXJpdHkgUmVzZWFyY2gg
R3JvdXAxFTATBgNVBAMTDElTUkcgUm9vdCBYMjAeFw0yMDA5MDQwMDAwMDBaFw00
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tL4ndQavEi51mI38AjEAi/V3bNTIZargCyzuFJ0nN6T5U6VR5CmD1/iQMVtCnwr1
/q4AaOeMSQ+2b1tbFfLn
-----END CERTIFICATE-----
-----BEGIN CERTIFICATE-----
MIIDQTCCAimgAwIBAgITBmyfz5m/jAo54vB4ikPmljZbyjANBgkqhkiG9w0BAQsF
ADA5MQswCQYDVQQGEwJVUzEPMA0GA1UEChMGQW1hem9uMRkwFwYDVQQDExBBbWF6
b24gUm9vdCBDQSAxMB4XDTE1MDUyNjAwMDAwMFoXDTM4MDExNzAwMDAwMFowOTEL
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5MsI+yMRQ+hDKXJioaldXgjUkK642M4UwtBV8ob2xJNDd2ZhwLnoQdeXeGADbkpy
rqXRfboQnoZsG4q5WTP468SQvvG5
-----END CERTIFICATE-----
-----BEGIN CERTIFICATE-----
MIID7zCCAtegAwIBAgIBADANBgkqhkiG9w0BAQsFADCBmDELMAkGA1UEBhMCVVMx
EDAOBgNVBAgTB0FyaXpvbmExEzARBgNVBAcTClNjb3R0c2RhbGUxJTAjBgNVBAoT
HFN0YXJmaWVsZCBUZWNobm9sb2dpZXMsIEluYy4xOzA5BgNVBAMTMlN0YXJmaWVs
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0q23KXB56jzaYyWf/Wi3MOxw+3WKt21gZ7IeyLnp2KhvAotnDU0mV3HaIPzBSlCN
sSi6
-----END CERTIFICATE-----
-----BEGIN CERTIFICATE-----
MIIFVzCCAz+gAwIBAgINAgPlk28xsBNJiGuiFzANBgkqhkiG9w0BAQwFADBHMQsw
CQYDVQQGEwJVUzEiMCAGA1UEChMZR29vZ2xlIFRydXN0IFNlcnZpY2VzIExMQzEU
MBIGA1UEAxMLR1RTIFJvb3QgUjEwHhcNMTYwNjIyMDAwMDAwWhcNMzYwNjIyMDAw
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2tIMPNuzjsmhDYAPexZ3FL//2wmUspO8IFgV6dtxQ/PeEMMA3KgqlbbC1j+Qa3bb
bP6MvPJwNQzcmRk13NfIRmPVNnGuV/u3gm3c
-----END CERTIFICATE-----
-----BEGIN CERTIFICATE-----
MIICCTCCAY6gAwIBAgINAgPlwGjvYxqccpBQUjAKBggqhkjOPQQDAzBHMQswCQYD
VQQGEwJVUzEiMCAGA1UEChMZR29vZ2xlIFRydXN0IFNlcnZpY2VzIExMQzEUMBIG
A1UEAxMLR1RTIFJvb3QgUjQwHhcNMTYwNjIyMDAwMDAwWhcNMzYwNjIyMDAwMDAw
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p/SgguMh1YQdc4acLa/KNJvxn7kjNuK8YAOdgLOaVsjh4rsUecrNIdSUtUlD
-----END CERTIFICATE-----
)PEM";
// ===== fin certs.h =====

// Tipos aquí arriba para los prototipos automáticos de Arduino.
struct SkyView { int cx, cy, r; float lst, slat, clat; };
struct NightHour { time_t t; float q; int cloud; bool moonUp, dark, gcUp; };
enum Kind : uint8_t { K_NONE, K_STAR, K_PLANET, K_MOON, K_SUN };

// ---------- Hardware de la CYD ----------
SPIClass lcdBus(HSPI), touchBus(VSPI);
Adafruit_ILI9341 lcd(&lcdBus, 2, 15, -1);
Adafruit_GFX* gfx = &lcd;  // se cambia por un lienzo en memoria para mandar capturas por USB
XPT2046_Touchscreen touch(33, 36);
constexpr int LED_R = 4, LED_G = 16, LED_B = 17;  // activo a nivel bajo
constexpr int PIN_BL = 21;
constexpr int W = 320, H = 240;

// ---------- Colores (pasan por C() para el modo rojo) ----------
constexpr uint16_t BG = 0x0021, HEAD = 0x0884, SKY = 0x00A6, SKYLINE = 0x194B, TXT = 0xE77E, DIM = 0x8C95;
constexpr uint16_t ACC = 0x7DDF, AMB = 0xFD84, GRN = 0x5E91, RED = 0xFB6D, CLINE = 0x2B16, BTN = 0x1109;

bool redMode = false;
uint16_t C(uint16_t c) {
  if (!redMode) return c;
  int r = (c >> 11) & 31, g = (c >> 5) & 63, b = c & 31;
  int l = (r * 2 * 77 + g * 150 + b * 2 * 29) >> 9;  // luminancia 0-31 aprox.
  return (uint16_t)(min(31, l + (l > 0 ? 2 : 0)) << 11);
}

// ---------- Estado ----------
Preferences prefs;
WebServer web(80);
DNSServer dns;
bool portalMode = false;
String scannedOptions;
float homeLat = 40.4168f, homeLon = -3.7038f;  // Madrid por defecto
char locSource[12] = "defecto";
int bortle = 5;
float ax = 0, bx = 0, cx = 0, ay = 0, by = 0, cy = 0;
int tab = 0, shiftH = 0, previewBortle = 0;
int32_t utcOffset = 3600;  // segundos; lo corrige Open-Meteo
bool timeOk = false;

// Nubes: 48 horas desde la medianoche local del día de la descarga.
int8_t cloud[48];
time_t cloudStart = 0;  // UTC de la primera hora
uint32_t weatherAt = 0;
// Kp: últimas observaciones y previsión (cada 3 h, UTC).
constexpr int KPN = 96;
float kpVal[KPN];
time_t kpTime[KPN];
int kpN = 0;
uint32_t kpAt = 0;
char netError[40] = "";

const char* const TABS[6] = {"CIELO", "LUNA", "NOCHE", "AURORA", "TU CIELO", "FOTO"};
const char* const PLANET_NAMES[5] = {"Mercurio", "Venus", "Marte", "Júpiter", "Saturno"};
const uint16_t PLANET_COL[5] = {0xBDF7, 0xFFB5, 0xFB08, 0xFE8F, 0xEEAB};
const char* const BORTLE_NAMES[10] = {"", "cielo excelente", "cielo oscuro", "rural", "rural-suburbano", "suburbano",
                                      "suburbio brillante", "periferia urbana", "ciudad", "centro de ciudad"};
const char* const DIRS[8] = {"Norte", "Noreste", "Este", "Sureste", "Sur", "Suroeste", "Oeste", "Noroeste"};

// ---------- Texto con acentos (fuente clásica CP437) ----------
uint8_t mapUtf8(const uint8_t*& p) {
  uint8_t c = *p++;
  if (c < 0x80) return c;
  if (c == 0xC3) {
    switch (*p++) {
      case 0xA1: return 0xA0; case 0xA9: return 0x82; case 0xAD: return 0xA1;
      case 0xB3: return 0xA2; case 0xBA: return 0xA3; case 0xB1: return 0xA4;
      case 0x91: return 0xA5; case 0xBC: return 0x81; case 0x89: return 0x90;
      case 0x81: return 'A'; case 0x8D: return 'I'; case 0x93: return 'O'; case 0x9A: return 'U';
      default: return '?';
    }
  }
  if (c == 0xC2) { uint8_t d = *p++; return d == 0xBF ? 0xA8 : d == 0xA1 ? 0xAD : d == 0xBA ? 0xF8 : d == 0xB7 ? 0xFA : d == 0xB0 ? 0xF8 : '?'; }
  while ((*p & 0xC0) == 0x80) p++;
  return '?';
}
int textWidth(const char* s, uint8_t size) { int n = 0; for (const uint8_t* p = (const uint8_t*)s; *p;) { mapUtf8(p); n++; } return n * 6 * size; }
void put(int x, int y, const char* s, uint16_t fg, uint8_t size = 1, int32_t bg = -1) {
  gfx->setFont();
  uint16_t f = C(fg), b = bg < 0 ? f : C((uint16_t)bg);
  for (const uint8_t* p = (const uint8_t*)s; *p; x += 6 * size) gfx->drawChar(x, y, mapUtf8(p), f, b, size);
}
void putCenter(int cxm, int y, const char* s, uint16_t fg, uint8_t size = 1, int32_t bg = -1) { put(cxm - textWidth(s, size) / 2, y, s, fg, size, bg); }
void setLed(bool r, bool g, bool b) { digitalWrite(LED_R, !r); digitalWrite(LED_G, !g); digitalWrite(LED_B, !b); }
void btn(int x, int y, int w, int h, const char* s, uint16_t fg, uint16_t bg = BTN) {
  gfx->fillRoundRect(x, y, w, h, 4, C(bg));
  putCenter(x + w / 2, y + (h - 8) / 2, s, fg, 1, bg);
}

// ---------- Tiempo ----------
int64_t daysFromCivil(int y, int m, int d) {  // algoritmo de Howard Hinnant
  y -= m <= 2;
  int64_t era = (y >= 0 ? y : y - 399) / 400;
  unsigned yoe = (unsigned)(y - era * 400), doy = (153 * (m + (m > 2 ? -3 : 9)) + 2) / 5 + d - 1;
  unsigned doe = yoe * 365 + yoe / 4 - yoe / 100 + doy;
  return era * 146097 + (int64_t)doe - 719468;
}
time_t parseIso(const char* s) {  // "2026-11-05T18:00[:00]" -> segundos (sin zona)
  int y, mo, d, h = 0, mi = 0;
  if (sscanf(s, "%d-%d-%dT%d:%d", &y, &mo, &d, &h, &mi) < 3) return 0;
  return (time_t)(daysFromCivil(y, mo, d) * 86400 + h * 3600 + mi * 60);
}
time_t nowUtc() { return time(nullptr); }
time_t viewUtc() { return nowUtc() + shiftH * 3600; }
void fmtHM(time_t utc, char* out) { time_t l = utc + utcOffset; snprintf(out, 6, "%02d:%02d", (int)(l % 86400 / 3600), (int)(l % 3600 / 60)); }
const char* dirName(double az) { return DIRS[(int)((az + 22.5) / 45) % 8]; }

double lstAt(time_t utc) { return astro::rev(astro::gmst(astro::dayNumber(utc)) + homeLon); }
double sunAlt(time_t utc) { astro::Eq s = astro::sun(astro::dayNumber(utc)); return astro::toHorizon(s.ra, s.dec, lstAt(utc), homeLat).alt; }
double moonAlt(time_t utc) { return astro::moonHorizon(astro::dayNumber(utc), lstAt(utc), homeLat).alt; }

// Siguiente cruce de una altura (sube=true: al subir) en las próximas `hours`, pasos de 10 min.
time_t nextCross(double (*altFn)(time_t), time_t from, double level, bool rising, int hours) {
  double prev = altFn(from);
  for (time_t t = from + 600; t <= from + hours * 3600; t += 600) {
    double a = altFn(t);
    if (rising ? (prev < level && a >= level) : (prev > level && a <= level)) {
      time_t lo = t - 600, hi = t;  // afinar por bisección
      for (int i = 0; i < 8; i++) { time_t mid = (lo + hi) / 2; bool up = altFn(mid) >= level; if (up == rising) hi = mid; else lo = mid; }
      return hi;
    }
    prev = a;
  }
  return 0;
}

// ---------- Ubicación desde texto (coordenadas o enlace de Google Maps) ----------
String urlDecode(const String& s) {
  String o;
  for (size_t i = 0; i < s.length(); i++) {
    char c = s[i];
    if (c == '%' && i + 2 < s.length()) { o += (char)strtol(s.substring(i + 1, i + 3).c_str(), nullptr, 16); i += 2; }
    else o += c == '+' ? ' ' : c;
  }
  return o;
}
bool numPairAt(const char* p, float& la, float& lo) {
  char* e;
  double a = strtod(p, &e);
  if (e == p || !memchr(p, '.', e - p)) return false;
  while (*e == ' ' || *e == ',' || *e == ';') { if (*e == ',' || *e == ';') { e++; while (*e == ' ') e++; break; } e++; }
  const char* q = e;
  if (*q == '+') q++;
  double b = strtod(q, &e);
  if (e == q || !memchr(q, '.', e - q)) return false;
  if (a < -90 || a > 90 || b < -180 || b > 180 || (a == 0 && b == 0)) return false;
  la = a; lo = b;
  return true;
}
bool parseLocation(const String& raw, float& la, float& lo) {
  String s = urlDecode(raw);
  const char* c = s.c_str();
  const char* p3 = strstr(c, "!3d");  // marcador del sitio: más fiable que la vista del mapa
  if (p3) {
    const char* p4 = strstr(p3, "!4d");
    if (p4) {
      float a = atof(p3 + 3), b = atof(p4 + 3);
      if (a >= -90 && a <= 90 && b >= -180 && b <= 180 && (a || b)) { la = a; lo = b; return true; }
    }
  }
  const char* at = strchr(c, '@');
  for (const char* p = at ? at + 1 : c; *p; p++)
    if ((*p == '-' || isdigit((unsigned char)*p)) && (p == c || !isdigit((unsigned char)p[-1]) && p[-1] != '.') && numPairAt(p, la, lo)) return true;
  return false;
}

// ---------- Red ----------
bool httpsGet(const String& url, JsonDocument& doc, JsonDocument* filter) {
  WiFiClientSecure client;
  client.setCACert(ROOT_CA);
  client.setTimeout(12);
  HTTPClient http;
  http.setTimeout(12000);
  if (!http.begin(client, url)) { strlcpy(netError, "No se pudo abrir HTTPS", sizeof(netError)); return false; }
  http.useHTTP10(true);  // sin respuesta troceada (chunked), que rompe la lectura directa del JSON
  http.setUserAgent("AstroCYD-MS/1.0 (CYD; github.com/msrobotika)");
  int code = http.GET();
  if (code != 200) { snprintf(netError, sizeof(netError), "HTTP %d", code); http.end(); return false; }
  DeserializationError err = filter ? deserializeJson(doc, http.getStream(), DeserializationOption::Filter(*filter))
                                    : deserializeJson(doc, http.getStream());
  http.end();
  if (err) { snprintf(netError, sizeof(netError), "JSON %s", err.c_str()); return false; }
  netError[0] = 0;
  return true;
}

bool fetchWeather() {
  char url[200];
  snprintf(url, sizeof(url), "https://api.open-meteo.com/v1/forecast?latitude=%.3f&longitude=%.3f&hourly=cloud_cover&timezone=auto&forecast_days=2", homeLat, homeLon);
  JsonDocument filter;
  filter["utc_offset_seconds"] = true;
  filter["hourly"]["time"][0] = true;
  filter["hourly"]["cloud_cover"] = true;
  JsonDocument doc;
  if (!httpsGet(url, doc, &filter)) { Serial.printf("MSR_ASTRO_WEATHER_ERROR %s\n", netError); return false; }
  utcOffset = doc["utc_offset_seconds"] | utcOffset;
  cloudStart = parseIso(doc["hourly"]["time"][0] | "") - utcOffset;
  JsonArray cc = doc["hourly"]["cloud_cover"].as<JsonArray>();
  int n = 0;
  for (JsonVariant v : cc) { if (n >= 48) break; cloud[n++] = v.isNull() ? -1 : v.as<int>(); }
  for (; n < 48; n++) cloud[n] = -1;
  Serial.printf("MSR_ASTRO_WEATHER_OK offset=%ld hours=%d first=%d\n", (long)utcOffset, (int)cc.size(), cloud[0]);
  return cloudStart > 0;
}
int cloudAt(time_t utc) {
  if (!cloudStart) return -1;
  long i = (long)((utc - cloudStart) / 3600);
  return i >= 0 && i < 48 ? cloud[i] : -1;
}

bool fetchKp() {
  JsonDocument filter;
  filter[0]["time_tag"] = true;
  filter[0]["kp"] = true;
  JsonDocument doc;
  if (!httpsGet("https://services.swpc.noaa.gov/products/noaa-planetary-k-index-forecast.json", doc, &filter)) {
    Serial.printf("MSR_ASTRO_KP_ERROR %s\n", netError);
    return false;
  }
  JsonArray a = doc.as<JsonArray>();
  int skip = max(0, (int)a.size() - KPN), n = 0, i = 0;
  for (JsonObject o : a) {
    if (i++ < skip) continue;
    kpTime[n] = parseIso(o["time_tag"] | "");
    kpVal[n] = o["kp"] | 0.0f;
    n++;
  }
  kpN = n;
  Serial.printf("MSR_ASTRO_KP_OK n=%d\n", n);
  return n > 0;
}
float kpNow() {  // valor del intervalo de 3 h en curso
  time_t t = nowUtc();
  float v = -1;
  for (int i = 0; i < kpN; i++) if (kpTime[i] <= t) v = kpVal[i];
  return v;
}
float kpMaxDay(int dayOffset) {  // día local: 0 hoy, 1 mañana...
  time_t l0 = (nowUtc() + utcOffset) / 86400 * 86400 + dayOffset * 86400LL - utcOffset;
  float m = -1;
  for (int i = 0; i < kpN; i++) if (kpTime[i] >= l0 && kpTime[i] < l0 + 86400) m = max(m, kpVal[i]);
  return m;
}

bool ipLocate() {
  JsonDocument filter;
  filter["latitude"] = true;
  filter["longitude"] = true;
  JsonDocument doc;
  if (!httpsGet("https://ipapi.co/json/", doc, &filter) || doc["latitude"].isNull()) { Serial.printf("MSR_ASTRO_IPLOC_ERROR %s\n", netError); return false; }
  homeLat = doc["latitude"].as<float>();
  homeLon = doc["longitude"].as<float>();
  strlcpy(locSource, "internet", sizeof(locSource));
  prefs.putFloat("lat", homeLat); prefs.putFloat("lon", homeLon); prefs.putString("src", locSource);
  Serial.println("MSR_ASTRO_IPLOC_OK");
  return true;
}

// Sigue las redirecciones del enlace corto de Google Maps hasta encontrar coordenadas.
bool resolveMapsLink(String url) {
  for (int hop = 0; hop < 5; hop++) {
    float la, lo;
    if (parseLocation(url, la, lo)) {
      homeLat = la; homeLon = lo;
      strlcpy(locSource, "enlace", sizeof(locSource));
      prefs.putFloat("lat", la); prefs.putFloat("lon", lo); prefs.putString("src", locSource);
      prefs.remove("link");
      Serial.printf("MSR_ASTRO_LINK_OK hops=%d\n", hop);
      return true;
    }
    if (!url.startsWith("https://")) break;
    WiFiClientSecure client;
    client.setCACert(ROOT_CA);
    HTTPClient http;
    http.setFollowRedirects(HTTPC_DISABLE_FOLLOW_REDIRECTS);
    if (!http.begin(client, url)) break;
    const char* keys[] = {"Location"};
    http.collectHeaders(keys, 1);
    int code = http.GET();
    String next = http.header("Location");
    http.end();
    Serial.printf("MSR_ASTRO_LINK_HOP code=%d\n", code);
    if (next.isEmpty()) break;
    url = next;
  }
  Serial.println("MSR_ASTRO_LINK_FAIL");
  return false;
}

// ---------- Bluetooth: botón de foto ----------
// El núcleo esp32 3.x libera la memoria de Bluetooth si cree que nadie la usa; sin esto la placa se reinicia.
extern "C" bool btInUse(void) { return true; }
const uint8_t REPORT_MAP[] = {  // control de consumo (volumen +), 16 bits
  0x05, 0x0C, 0x09, 0x01, 0xA1, 0x01, 0x85, 0x01,
  0x15, 0x00, 0x26, 0xFF, 0x03, 0x19, 0x00, 0x2A, 0xFF, 0x03, 0x75, 0x10, 0x95, 0x01, 0x81, 0x00, 0xC0};
NimBLEHIDDevice* hid = nullptr;
NimBLECharacteristic* mediaIn = nullptr;
volatile bool bleConnected = false, bleDirty = false;
bool bleStarted = false;
class BleEvents : public NimBLEServerCallbacks {
  void onConnect(NimBLEServer*, NimBLEConnInfo&) override { bleConnected = true; bleDirty = true; Serial.println("MSR_ASTRO_BLE_CONNECTED"); }
  void onDisconnect(NimBLEServer*, NimBLEConnInfo&, int r) override { bleConnected = false; bleDirty = true; Serial.printf("MSR_ASTRO_BLE_DISCONNECTED reason=%d\n", r); NimBLEDevice::startAdvertising(); }
};
void startBle() {
  if (bleStarted) return;
  bleStarted = true;
  NimBLEDevice::init("AstroCYD MS");
  NimBLEDevice::setSecurityAuth(true, false, true);
  NimBLEDevice::setSecurityIOCap(BLE_HS_IO_NO_INPUT_OUTPUT);
  NimBLEServer* server = NimBLEDevice::createServer();
  server->setCallbacks(new BleEvents());
  server->advertiseOnDisconnect(true);
  hid = new NimBLEHIDDevice(server);
  mediaIn = hid->getInputReport(1);
  hid->setManufacturer("MS Robotika");
  hid->setPnp(0x02, 0xE502, 0xA112, 0x0100);
  hid->setHidInfo(0x00, 0x01);
  hid->setReportMap((uint8_t*)REPORT_MAP, sizeof(REPORT_MAP));
  hid->setBatteryLevel(100);
  hid->startServices();
  NimBLEAdvertising* adv = NimBLEDevice::getAdvertising();
  adv->setAppearance(HID_KEYBOARD);
  adv->addServiceUUID(hid->getHidService()->getUUID());
  adv->setName("AstroCYD MS");
  adv->enableScanResponse(true);
  adv->start();
  Serial.printf("MSR_ASTRO_BLE_ADVERTISING heap=%u\n", (unsigned)ESP.getFreeHeap());
}
bool shutter() {
  if (!bleConnected) return false;
  uint8_t down[2] = {0xE9, 0x00}, up[2] = {0, 0};  // Volume Increment
  mediaIn->notify(down, 2);
  delay(40);
  mediaIn->notify(up, 2);
  return true;
}

// Intervalómetro
int ivSec = 30, ivCount = 120, ivDelay = 5, shots = 0;
bool shooting = false;
uint32_t nextShotAt = 0;

// ---------- Proyección del cielo ----------
// Equidistante azimutal: cenit en el centro, horizonte en el borde, norte arriba y este a la
// izquierda (como al mirar hacia arriba). Devuelve false si está bajo el horizonte.
bool project(const SkyView& v, float raDeg, float decDeg, int& x, int& y, float* altOut = nullptr, float* azOut = nullptr) {
  float ha = (v.lst - raDeg) * (float)DEG_TO_RAD, dec = decDeg * (float)DEG_TO_RAD;
  float cd = cosf(dec), sd = sinf(dec), xx = cosf(ha) * cd, yy = sinf(ha) * cd;
  float zh = xx * v.clat + sd * v.slat;
  float alt = asinf(fmaxf(-1, fminf(1, zh))) * RAD_TO_DEG;
  float xh = xx * v.slat - sd * v.clat;
  float az = atan2f(yy, xh) * RAD_TO_DEG + 180;
  if (altOut) *altOut = alt;
  if (azOut) *azOut = az;
  if (alt < 0) return false;
  float rr = (90 - alt) / 90 * v.r, a = az * (float)DEG_TO_RAD;
  x = v.cx - lroundf(rr * sinf(a));
  y = v.cy - lroundf(rr * cosf(a));
  return true;
}
SkyView makeView(int cxv, int cyv, int r, time_t utc) {
  return {cxv, cyv, r, (float)lstAt(utc), sinf(homeLat * DEG_TO_RAD), cosf(homeLat * DEG_TO_RAD)};
}
inline float starRa(const Star& s) { return s.ra * (360.0f / 65536); }
inline float starDec(const Star& s) { return s.dec / 100.0f; }
uint16_t starColor(int bv10, float bright) {
  int r, g, b;  // azul-blanco a naranja según el índice de color B-V
  if (bv10 < 0) { r = 170; g = 200; b = 255; } else if (bv10 < 5) { r = 235; g = 240; b = 255; }
  else if (bv10 < 10) { r = 255; g = 235; b = 190; } else { r = 255; g = 190; b = 140; }
  r *= bright; g *= bright; b *= bright;
  return ((r & 0xF8) << 8) | ((g & 0xFC) << 3) | (b >> 3);
}
// Dibuja las estrellas hasta `limMag`; guarda su posición si sx/sy no son nulos. Devuelve cuántas.
int drawStars(const SkyView& v, float limMag, int16_t* sx, int16_t* sy, bool big) {
  int n = 0;
  for (int i = 0; i < STAR_COUNT; i++) {
    const Star& s = STARS[i];
    float mag = s.mag10 / 10.0f;
    if (mag > limMag) { if (sx) sx[i] = -1; continue; }
    int x, y;
    if (!project(v, starRa(s), starDec(s), x, y)) { if (sx) sx[i] = -1; continue; }
    if (sx) { sx[i] = x; sy[i] = y; }
    n++;
    float bright = mag < 3 ? 1.0f : fmaxf(0.35f, 1.0f - (mag - 3) * 0.22f);
    uint16_t c = C(starColor(s.bv10, bright));
    if (big && mag < 0.5f) gfx->fillCircle(x, y, 2, c);
    else if (big && mag < 1.5f) gfx->fillCircle(x, y, 1, c);
    else if (mag < 2.5f) gfx->fillRect(x, y, 2, 2, c);
    else gfx->drawPixel(x, y, c);
  }
  return n;
}

// ---------- Pantalla CIELO ----------
constexpr int SKY_CX = 106, SKY_CY = 119, SKY_R = 98;
int16_t starX[STAR_COUNT], starY[STAR_COUNT];
Kind selKind = K_NONE;
int selIdx = -1;
int planetX[5], planetY[5], moonX = -99, moonY = -99, sunX = -99, sunY = -99;
int visibleStars = 0;

void drawMoonDisc(int x0, int y0, int r, double age, bool south, uint16_t lit, uint16_t dark) {
  for (int dy = -r; dy <= r; dy++) {
    float w = sqrtf((float)(r * r - dy * dy));
    float c = cosf(age * DEG_TO_RAD);
    float a, b;  // tramo iluminado en x (hemisferio norte: crece por la derecha)
    if (age < 180) { a = w * c; b = w; } else { a = -w; b = -w * c; }
    if (south) { float t = -b; b = -a; a = t; }
    gfx->drawFastHLine(x0 - (int)w, y0 + dy, 2 * (int)w + 1, C(dark));
    if (b > a) gfx->drawFastHLine(x0 + (int)lroundf(a), y0 + dy, (int)lroundf(b - a) + 1, C(lit));
  }
}

void drawSky() {
  time_t t = viewUtc();
  double d = astro::dayNumber(t);
  SkyView v = makeView(SKY_CX, SKY_CY, SKY_R, t);
  double sAlt = sunAlt(t);
  uint16_t skyBg = sAlt > -0.8 ? 0x2A6F : sAlt > -12 ? 0x10EC : SKY;
  gfx->fillRect(0, 19, 211, 201, C(BG));
  gfx->fillCircle(SKY_CX, SKY_CY, SKY_R, C(skyBg));
  gfx->drawCircle(SKY_CX, SKY_CY, SKY_R, C(SKYLINE));
  gfx->drawCircle(SKY_CX, SKY_CY, SKY_R * 2 / 3, C(0x10A8));  // 30° de altura
  // Constelaciones: trazos cuyos dos extremos están sobre el horizonte.
  for (int p = 0; p < CPOLY_COUNT; p++) {
    const CPoly& pl = CPOLYS[p];
    int px = 0, py = 0;
    bool prevUp = false;
    for (int k = 0; k < pl.count; k++) {
      const CPoint& q = CPOINTS[pl.first + k];
      int x, y;
      bool up = project(v, q.ra * (360.0f / 65536), q.dec / 100.0f, x, y);
      if (up && prevUp) gfx->drawLine(px, py, x, y, C(CLINE));
      px = x; py = y; prevUp = up;
    }
  }
  float lim = astro::limitingMag(bortle);
  visibleStars = drawStars(v, lim, starX, starY, true);
  for (int c = 0; c < CON_COUNT; c++) {
    if (CLABELS[c].rank > 1) continue;
    int x, y;
    float alt;
    if (project(v, CLABELS[c].ra * (360.0f / 65536), CLABELS[c].dec / 100.0f, x, y, &alt) && alt > 12) {
      int w = textWidth(CON_NAMES[c], 1);
      if (x - w / 2 > 2 && x + w / 2 < 210) put(x - w / 2, y + 6, CON_NAMES[c], 0x6B7E);
    }
  }
  // Planetas, Luna y Sol
  for (int p = 0; p < 5; p++) {
    astro::Planet pl = astro::planet(p, d);
    planetX[p] = -99;
    int x, y;
    if (project(v, pl.eq.ra, pl.eq.dec, x, y)) {
      planetX[p] = x; planetY[p] = y;
      gfx->fillCircle(x, y, 3, C(PLANET_COL[p]));
      int tw = textWidth(PLANET_NAMES[p], 1);
      put(x + 5 + tw < 210 ? x + 5 : x - 5 - tw, y - 3, PLANET_NAMES[p], PLANET_COL[p]);  // sin pisar el panel
    }
  }
  astro::MoonState m = astro::moon(d);
  astro::Hor mh = astro::moonHorizon(d, v.lst, homeLat);
  moonX = -99;
  if (mh.alt > 0) {
    float rr = (90 - mh.alt) / 90 * SKY_R, a = mh.az * DEG_TO_RAD;
    moonX = SKY_CX - lroundf(rr * sinf(a)); moonY = SKY_CY - lroundf(rr * cosf(a));
    double illum, age;
    astro::moonPhase(d, illum, age);
    drawMoonDisc(moonX, moonY, 6, age, homeLat < 0, 0xEF3A, 0x2124);
  }
  astro::Eq se = astro::sun(d);
  sunX = -99;
  int x, y;
  if (project(v, se.ra, se.dec, x, y)) { sunX = x; sunY = y; gfx->fillCircle(x, y, 7, C(0xFE60)); }
  (void)m;
  // Puntos cardinales
  put(SKY_CX - 2, SKY_CY - SKY_R - 0, "N", ACC, 1, skyBg);
  put(SKY_CX - SKY_R + 2, SKY_CY - 3, "E", ACC, 1, skyBg);
  put(SKY_CX + SKY_R - 7, SKY_CY - 3, "O", ACC, 1, skyBg);
  put(SKY_CX - 2, SKY_CY + SKY_R - 8, "S", ACC, 1, skyBg);
  if (sAlt > -0.8) put(4, 209, "De día: el Sol tapa las estrellas", AMB);
  // Resalte del objeto elegido
  int hx = -99, hy = 0;
  if (selKind == K_STAR && selIdx >= 0 && starX[selIdx] >= 0) { hx = starX[selIdx]; hy = starY[selIdx]; }
  else if (selKind == K_PLANET && planetX[selIdx] > -99) { hx = planetX[selIdx]; hy = planetY[selIdx]; }
  else if (selKind == K_MOON && moonX > -99) { hx = moonX; hy = moonY; }
  else if (selKind == K_SUN && sunX > -99) { hx = sunX; hy = sunY; }
  if (hx > -99) gfx->drawCircle(hx, hy, 9, C(AMB));
}

void drawSkyPanel() {
  const int x0 = 213, w = 105;
  gfx->fillRect(x0, 19, W - x0, 201, C(BG));
  gfx->drawRoundRect(x0, 22, w, 150, 5, C(SKYLINE));
  time_t t = viewUtc();
  double d = astro::dayNumber(t), lst = lstAt(t);
  char line[40];
  const char* name = nullptr;
  char sub[28] = "";
  double alt = 0, az = 0, mag = 99;
  bool have = true;
  if (selKind == K_STAR && selIdx >= 0) {
    const Star& s = STARS[selIdx];
    astro::Hor h = astro::toHorizon(starRa(s), starDec(s), lst, homeLat);
    alt = h.alt; az = h.az; mag = s.mag10 / 10.0;
    name = s.name != 255 ? STAR_NAMES[s.name] : "Estrella";
    if (s.con != 255) snprintf(sub, sizeof(sub), "en %s", CON_NAMES[s.con]); else strlcpy(sub, "estrella", sizeof(sub));
  } else if (selKind == K_PLANET) {
    astro::Planet p = astro::planet(selIdx, d);
    astro::Hor h = astro::toHorizon(p.eq.ra, p.eq.dec, lst, homeLat);
    alt = h.alt; az = h.az; mag = p.mag; name = PLANET_NAMES[selIdx]; strlcpy(sub, "planeta", sizeof(sub));
  } else if (selKind == K_MOON) {
    astro::Hor h = astro::moonHorizon(d, lst, homeLat);
    double illum, age;
    astro::moonPhase(d, illum, age);
    alt = h.alt; az = h.az; name = "Luna";
    snprintf(sub, sizeof(sub), "iluminada %d%%", (int)lround(illum * 100));
  } else if (selKind == K_SUN) {
    astro::Eq s = astro::sun(d);
    astro::Hor h = astro::toHorizon(s.ra, s.dec, lst, homeLat);
    alt = h.alt; az = h.az; name = "Sol"; strlcpy(sub, "no lo mires", sizeof(sub));
  } else have = false;
  if (!have) {
    put(x0 + 7, 34, "Toca una", DIM); put(x0 + 7, 46, "estrella o un", DIM); put(x0 + 7, 58, "planeta", DIM);
  } else {
    put(x0 + 5, 28, name, AMB, textWidth(name, 2) <= w - 8 ? 2 : 1);
    put(x0 + 5, 48, sub, DIM);
    put(x0 + 5, 64, "ALTURA", DIM);
    snprintf(line, sizeof(line), "%d\xC2\xB0", (int)lround(alt));
    put(x0 + 5, 74, line, TXT, 2);
    put(x0 + 5, 96, "MIRA HACIA", DIM);
    put(x0 + 5, 106, dirName(az), TXT, textWidth(dirName(az), 2) <= w - 8 ? 2 : 1);
    if (mag < 50) {
      put(x0 + 5, 128, "BRILLO", DIM);
      snprintf(line, sizeof(line), "magnitud %.1f", mag);
      put(x0 + 5, 138, line, TXT);
    }
    if (selKind == K_SUN) put(x0 + 5, 154, "Peligro: vista", RED);
  }
  btn(x0, 176, 33, 18, "-1h", ACC);
  btn(x0 + 36, 176, 33, 18, "ya", shiftH ? AMB : DIM);
  btn(x0 + 72, 176, 33, 18, "+1h", ACC);
  snprintf(line, sizeof(line), "%d estrellas", visibleStars);
  put(x0 + 2, 199, line, GRN);
  snprintf(line, sizeof(line), "Bortle %d, mag %.1f", bortle, astro::limitingMag(bortle));
  put(x0 + 2, 209, line, DIM);
}

void tapSky(int x, int y) {
  if (x >= 213 && y >= 176 && y < 194) {
    if (x < 246) shiftH = max(-12, shiftH - 1); else if (x < 282) shiftH = 0; else shiftH = min(12, shiftH + 1);
    drawAll();
    return;
  }
  if (x >= 210) return;
  int best = -1;
  Kind bk = K_NONE;
  long bd = 14 * 14;
  auto consider = [&](Kind k, int idx, int ox, int oy, long bias) {
    if (ox <= -99) return;
    long dd = (long)(ox - x) * (ox - x) + (long)(oy - y) * (oy - y);
    if (dd <= 14 * 14 && dd + bias < bd) { bd = dd + bias; best = idx; bk = k; }
  };
  for (int p = 0; p < 5; p++) consider(K_PLANET, p, planetX[p], planetY[p], -60);
  consider(K_MOON, 0, moonX, moonY, -80);
  consider(K_SUN, 0, sunX, sunY, -80);
  for (int i = 0; i < STAR_COUNT; i++)
    if (starX[i] >= 0) consider(K_STAR, i, starX[i], starY[i], (long)(STARS[i].mag10 * 3));  // prefiere las brillantes
  if (best >= 0) { selKind = bk; selIdx = best; }
  drawSky();
  drawSkyPanel();
}

// ---------- Pantalla LUNA ----------
const char* phaseName(double age) {
  if (age < 10 || age > 350) return "Luna nueva";
  if (age < 80) return "Creciente";
  if (age < 100) return "Cuarto creciente";
  if (age < 170) return "Gibosa creciente";
  if (age < 190) return "Luna llena";
  if (age < 260) return "Gibosa menguante";
  if (age < 280) return "Cuarto menguante";
  return "Menguante";
}
time_t nextPhase(time_t from, double target) {  // primer instante en que la edad pasa por target
  double prev, illum;
  astro::moonPhase(astro::dayNumber(from), illum, prev);
  for (time_t t = from + 3600; t < from + 32 * 86400LL; t += 3600) {
    double age;
    astro::moonPhase(astro::dayNumber(t), illum, age);
    double a = astro::rev(prev - target + 180), b = astro::rev(age - target + 180);
    if (a < 180 && b >= 180) return t;
    prev = age;
  }
  return 0;
}
void drawMoonTab() {
  gfx->fillRect(0, 19, W, 201, C(BG));
  time_t t = viewUtc();
  double d = astro::dayNumber(t), illum, age;
  astro::moonPhase(d, illum, age);
  drawMoonDisc(78, 112, 60, age, homeLat < 0, 0xEF3A, 0x18E3);
  char line[40], hm[6];
  const char* ph = phaseName(age);
  put(152, 28, ph, TXT, textWidth(ph, 2) <= W - 156 ? 2 : 1);
  snprintf(line, sizeof(line), "iluminada %d%%", (int)lround(illum * 100));
  put(152, 48, line, DIM);
  time_t rise = nextCross(moonAlt, t, 0, true, 26), set = nextCross(moonAlt, t, 0, false, 26);
  put(152, 66, "SALE", DIM);
  if (rise) { fmtHM(rise, hm); snprintf(line, sizeof(line), "%s %s", hm, dirName(astro::moonHorizon(astro::dayNumber(rise), lstAt(rise), homeLat).az)); }
  else strlcpy(line, "hoy no", sizeof(line));
  put(214, 66, line, TXT);
  put(152, 82, "SE PONE", DIM);
  if (set) { fmtHM(set, hm); snprintf(line, sizeof(line), "%s %s", hm, dirName(astro::moonHorizon(astro::dayNumber(set), lstAt(set), homeLat).az)); }
  else strlcpy(line, "hoy no", sizeof(line));
  put(214, 82, line, TXT);
  double alt = moonAlt(t);
  put(152, 98, "ALTURA", DIM);
  if (alt > 0) snprintf(line, sizeof(line), "%d\xC2\xB0", (int)lround(alt)); else strlcpy(line, "bajo horizonte", sizeof(line));
  put(214, 98, line, TXT);
  put(152, 114, "DIST.", DIM);
  snprintf(line, sizeof(line), "%ld km", (long)(astro::moon(d).eq.dist * 6378.137 / 1000) * 1000);
  put(214, 114, line, TXT);
  time_t nn = nextPhase(t, 0), nf = nextPhase(t, 180);
  put(160, 138, "LUNA NUEVA", DIM);
  snprintf(line, sizeof(line), "en %d días", nn ? (int)lround((nn - t) / 86400.0) : 0);
  put(232, 138, line, ACC);
  put(160, 154, "LUNA LLENA", DIM);
  snprintf(line, sizeof(line), "en %d días", nf ? (int)lround((nf - t) / 86400.0) : 0);
  put(232, 154, line, ACC);
  bool good = illum < 0.35 || (nn && (nn - t) < 5 * 86400);
  put(160, 178, good ? "Buenos días para" : "La Luna ilumina", good ? GRN : AMB);
  put(160, 190, good ? "fotos de estrellas" : "mucho: mejor fotos", good ? GRN : AMB);
  if (!good) put(160, 202, "de la propia Luna", AMB);
}

// ---------- Pantalla NOCHE ----------
NightHour nightH[13];
float nightQuality(time_t t, NightHour& h) {
  double d = astro::dayNumber(t), lst = lstAt(t);
  double sa = sunAlt(t), illum, age;
  astro::moonPhase(d, illum, age);
  double ma = astro::moonHorizon(d, lst, homeLat).alt;
  h.t = t;
  h.cloud = cloudAt(t);
  h.dark = sa < -18;
  h.moonUp = ma > 0;
  h.gcUp = astro::toHorizon(266.405, -28.936, lst, homeLat).alt > 10 && h.dark;
  float darkF = sa < -18 ? 1 : sa < -12 ? 0.5f : 0;
  float moonF = ma > 0 ? illum * (0.5f + 0.5f * fminf(1, ma / 30)) : 0;
  float cl = h.cloud < 0 ? 0.5f : h.cloud / 100.0f;
  h.q = (1 - cl) * (1 - 0.8f * moonF) * darkF;
  return h.q;
}
void drawNightTab() {
  gfx->fillRect(0, 19, W, 201, C(BG));
  time_t now = nowUtc(), local = now + utcOffset;
  long hourLocal = local % 86400 / 3600;
  time_t day0 = local / 86400 * 86400 - (hourLocal < 7 ? 86400 : 0);  // medianoche local del día de la noche
  time_t start = day0 + 18 * 3600 - utcOffset;
  for (int i = 0; i < 13; i++) nightQuality(start + i * 3600, nightH[i]);
  float bortleF = 1 - (bortle - 1) * 0.06f;
  int bestI = 0;
  float best = -1;
  for (int i = 0; i + 1 < 13; i++) {
    if (nightH[i + 1].t < now - 3600) continue;  // ventanas ya pasadas
    float s = (nightH[i].q + nightH[i + 1].q) / 2;
    if (s > best) { best = s; bestI = i; }
  }
  int score = (int)lroundf(fmaxf(0, best) * bortleF * 10);
  char line[48], a[6], b[6];
  uint16_t sc = score >= 7 ? GRN : score >= 4 ? AMB : RED;
  snprintf(line, sizeof(line), "%d", score);
  put(12, 28, line, sc, 5);
  put(12 + textWidth(line, 5) + 2, 48, "/10", sc, 2);
  fmtHM(nightH[bestI].t, a);
  fmtHM(nightH[bestI].t + 7200, b);
  if (best > 0.05f) { snprintf(line, sizeof(line), "Sal a las %s", a); put(100, 26, line, TXT, 2); snprintf(line, sizeof(line), "mejor ventana %s-%s", a, b); put(100, 46, line, DIM); }
  else { put(100, 26, "Mala noche", RED, 2); put(100, 46, "nubes, Luna o luz", DIM); }
  time_t dusk = nextCross(sunAlt, start - 5 * 3600, -18, false, 12), dawn = nextCross(sunAlt, start, -18, true, 18);
  if (dusk && dawn) { fmtHM(dusk, a); fmtHM(dawn, b); snprintf(line, sizeof(line), "noche cerrada %s > %s", a, b); }
  else strlcpy(line, "sin noche astronómica", sizeof(line));
  put(100, 58, line, DIM);
  if (!cloudStart) put(100, 70, "sin datos de nubes todavía", AMB);
  // Barras: verde = calidad, gris = nubes, blanco tenue = Luna arriba
  for (int i = 0; i < 13; i++) {
    int x = 12 + i * 23, base = 164;
    const NightHour& h = nightH[i];
    int qh = (int)(h.q * 76), ch = h.cloud < 0 ? 0 : h.cloud * 76 / 100 / 2;
    gfx->drawFastHLine(x, base, 18, C(SKYLINE));
    if (qh) gfx->fillRect(x, base - qh, 18, qh, C(h.moonUp ? 0x9CD3 : GRN));
    if (ch) gfx->fillRect(x, base - qh - ch, 18, ch, C(0x3A2C));
    if (i == bestI || i == bestI + 1) gfx->drawRect(x - 1, base - 80, 20, 81, C(AMB));
  }
  put(10, 168, "18h", DIM); put(150, 168, "00h", DIM); put(288, 168, "06h", DIM);
  gfx->fillRect(12, 180, 7, 6, C(GRN)); put(22, 179, "despejado", DIM);
  gfx->fillRect(84, 180, 7, 6, C(0x3A2C)); put(94, 179, "nubes", DIM);
  gfx->fillRect(134, 180, 7, 6, C(0x9CD3)); put(144, 179, "Luna arriba", DIM);
  int g0 = -1, g1 = -1;
  for (int i = 0; i < 13; i++) if (nightH[i].gcUp) { if (g0 < 0) g0 = i; g1 = i; }
  put(12, 194, "VÍA LÁCTEA", DIM);
  if (g0 >= 0) { fmtHM(nightH[g0].t, a); fmtHM(nightH[g1].t + 3600, b); snprintf(line, sizeof(line), "centro visible %s-%s", a, b); put(90, 194, line, GRN); }
  else put(90, 194, "centro no visible esta noche", DIM);
  put(12, 206, "TU CIELO", DIM);
  snprintf(line, sizeof(line), "Bortle %d, %s", bortle, BORTLE_NAMES[bortle]);
  put(90, 206, line, AMB);
}

// ---------- Pantalla AURORA ----------
void drawAuroraTab() {
  gfx->fillRect(0, 19, W, 201, C(BG));
  float gm = astro::geomagLat(homeLat, homeLon), need = astro::kpNeeded(fabsf(gm));
  float kp = kpNow();
  char line[48];
  // Indicador semicircular de 0 a 9
  int gx = 80, gy = 132, gr = 58;
  for (int k = 0; k <= 90; k++) {
    float a = (180 - k * 2) * DEG_TO_RAD;
    uint16_t c = kp >= 0 && k <= kp * 10 ? (k >= need * 10 ? RED : k >= 50 ? AMB : GRN) : SKYLINE;
    for (int t = 0; t < 10; t++) gfx->drawPixel(gx + (gr - t) * cosf(a), gy - (gr - t) * sinf(a), C(c));
  }
  if (need <= 9) { float a = (180 - need * 20) * DEG_TO_RAD; gfx->drawLine(gx + (gr - 14) * cosf(a), gy - (gr - 14) * sinf(a), gx + (gr + 4) * cosf(a), gy - (gr + 4) * sinf(a), C(TXT)); }
  if (kp >= 0) snprintf(line, sizeof(line), "Kp %.1f", kp); else strlcpy(line, "Kp ?", sizeof(line));
  putCenter(gx, gy - 24, line, TXT, 2);
  putCenter(gx, gy - 4, kp >= 5 ? "tormenta solar" : "sin tormenta", kp >= 5 ? AMB : DIM);
  put(gx - gr, gy + 6, "0", DIM); put(gx + gr - 6, gy + 6, "9", DIM);
  put(160, 28, "EN TU ZONA HACE FALTA", DIM);
  if (need > 9) strlcpy(line, "Kp 9 y suerte", sizeof(line)); else snprintf(line, sizeof(line), "Kp %d o más", (int)ceilf(fmaxf(0, need)));
  put(160, 40, line, AMB, 2);
  float m3 = -1;
  for (int i = 0; i < 3; i++) m3 = fmaxf(m3, kpMaxDay(i));
  const char* prob = m3 < 0 ? "sin datos" : m3 >= need ? "POSIBLE" : m3 >= need - 1.5f ? "baja" : "muy baja";
  put(160, 66, "PROBABILIDAD 3 DÍAS", DIM);
  put(160, 78, prob, m3 >= need ? GRN : TXT, 2);
  put(160, 102, "MÁXIMO PREVISTO", DIM);
  for (int i = 0; i < 3; i++) {
    float v = kpMaxDay(i);
    int x = 160 + i * 50;
    uint16_t c = v >= need ? RED : v >= 5 ? AMB : GRN;
    gfx->fillRoundRect(x, 114, 44, 30, 4, C(BTN));
    if (v >= 0) snprintf(line, sizeof(line), "%.0f", v); else strlcpy(line, "-", sizeof(line));
    putCenter(x + 22, 118, line, c, 2);
    putCenter(x + 22, 135, i == 0 ? "hoy" : i == 1 ? "mañana" : "pasado", DIM);
  }
  snprintf(line, sizeof(line), "latitud geomagnética %d\xC2\xB0", (int)lround(gm));
  put(12, 160, line, DIM);
  put(12, 174, "Mira al norte, lejos de luces. En el sur", DIM);
  put(12, 186, "de Europa solo se ven con tormentas muy", DIM);
  put(12, 198, "fuertes. Estimación aproximada.", DIM);
  put(12, 210, "LED rojo = aviso de aurora. Datos: NOAA", kp >= need ? RED : DIM);
}

// ---------- Pantalla TU CIELO ----------
void drawLightTab() {
  gfx->fillRect(0, 19, W, 201, C(BG));
  int b = previewBortle ? previewBortle : bortle;
  time_t t = viewUtc();
  SkyView l = makeView(80, 98, 66, t), r = makeView(240, 98, 66, t);
  gfx->fillCircle(80, 98, 66, C(SKY));
  uint16_t lpBg = b >= 8 ? 0x3166 : b >= 6 ? 0x2104 : b >= 4 ? 0x0886 : SKY;  // cielo más gris con más luz
  gfx->fillCircle(240, 98, 66, C(lpBg));
  int nIdeal = drawStars(l, 6.0f, nullptr, nullptr, false);
  int nReal = drawStars(r, astro::limitingMag(b), nullptr, nullptr, false);
  char line[40];
  putCenter(80, 170, "Cielo oscuro", DIM);
  snprintf(line, sizeof(line), "%d estrellas", nIdeal);
  putCenter(80, 182, line, TXT);
  snprintf(line, sizeof(line), "%s: Bortle %d", previewBortle && previewBortle != bortle ? "Si fuera" : "Tu cielo", b);
  putCenter(240, 170, line, AMB);
  snprintf(line, sizeof(line), "%d estrellas", nReal);
  putCenter(240, 182, line, TXT);
  putCenter(160, 196, BORTLE_NAMES[b], DIM);
  btn(160 - 70, 204, 40, 14, "-", ACC);
  btn(160 + 30, 204, 40, 14, "+", ACC);
  putCenter(160, 207, "probar", DIM);
}

// ---------- Pantalla FOTO ----------
void drawPhotoTab() {
  gfx->fillRect(0, 19, W, 201, C(BG));
  char line[40];
  snprintf(line, sizeof(line), "%03d", shots);
  putCenter(160, 26, line, TXT, 5);
  if (!bleConnected) strlcpy(line, "Empareja el móvil: AstroCYD MS", sizeof(line));
  else if (shooting) snprintf(line, sizeof(line), "de %s · siguiente en %lus", ivCount ? String(ivCount).c_str() : "sin fin",
                              (unsigned long)(nextShotAt > millis() ? (nextShotAt - millis() + 999) / 1000 : 0));
  else strlcpy(line, "móvil conectado · listo", sizeof(line));
  putCenter(160, 66, line, bleConnected ? DIM : AMB);
  struct { const char* label; char val[12]; } f[3];
  f[0].label = "CADA"; snprintf(f[0].val, 12, "%d s", ivSec);
  f[1].label = "FOTOS"; if (ivCount) snprintf(f[1].val, 12, "%d", ivCount); else strlcpy(f[1].val, "sin fin", 12);
  f[2].label = "RETARDO"; snprintf(f[2].val, 12, "%d s", ivDelay);
  for (int i = 0; i < 3; i++) {
    int x = i == 1 ? 166 : 12, y = i == 2 ? 126 : 82;
    gfx->fillRoundRect(x, y, 142, 38, 5, C(BTN));
    put(x + 6, y + 5, f[i].label, DIM, 1, BTN);
    put(x + 6, y + 18, f[i].val, TXT, 2, BTN);
    btn(x + 84, y + 8, 24, 22, "-", ACC, 0x2210);
    btn(x + 112, y + 8, 24, 22, "+", ACC, 0x2210);
  }
  long total = (long)ivDelay + (long)ivSec * max(0, ivCount - 1);
  gfx->fillRoundRect(166, 126, 142, 38, 5, C(BTN));
  put(172, 131, "DURA", DIM, 1, BTN);
  if (ivCount) snprintf(line, sizeof(line), "%ldh %02ldm", total / 3600, total % 3600 / 60); else strlcpy(line, "hasta parar", sizeof(line));
  put(172, 144, line, TXT, 2, BTN);
  btn(12, 172, 142, 30, shooting ? "PARAR" : "EMPEZAR", shooting ? RED : GRN, shooting ? 0x4882 : 0x0A24);
  btn(166, 172, 142, 30, "FOTO YA", ACC);
  put(12, 208, "Usa el modo noche o una app manual.", DIM);
}
void tapPhoto(int x, int y) {
  auto adj = [&](int i, int dir) {
    if (i == 0) ivSec = constrain(ivSec + dir * (ivSec >= 60 ? 10 : ivSec >= 10 ? 5 : 1), 1, 600);
    if (i == 1) ivCount = constrain(ivCount + dir * (ivCount >= 100 ? 50 : 10), 0, 990);
    if (i == 2) ivDelay = constrain(ivDelay + dir * 5, 0, 60);
  };
  for (int i = 0; i < 3; i++) {
    int bx0 = i == 1 ? 166 : 12, by0 = i == 2 ? 126 : 82;
    if (y >= by0 && y < by0 + 38 && !shooting) {
      if (x >= bx0 + 82 && x < bx0 + 110) { adj(i, -1); drawPhotoTab(); return; }
      if (x >= bx0 + 110 && x < bx0 + 140) { adj(i, 1); drawPhotoTab(); return; }
    }
  }
  if (y >= 172 && y < 202) {
    if (x < 160) {
      shooting = !shooting;
      if (shooting) { shots = 0; nextShotAt = millis() + ivDelay * 1000UL; }
      Serial.printf("MSR_ASTRO_INTERVAL %s sec=%d count=%d\n", shooting ? "START" : "STOP", ivSec, ivCount);
    } else if (shutter()) { shots++; Serial.println("MSR_ASTRO_SHOT manual"); }
    drawPhotoTab();
  }
}

// ---------- Marco común ----------
void drawHeader() {
  gfx->fillRect(0, 0, W, 18, C(HEAD));
  put(5, 5, "ASTROCYD", ACC, 1, HEAD);
  put(60, 5, TABS[tab], DIM, 1, HEAD);
  char line[32], hm[6];
  if (timeOk) {
    fmtHM(viewUtc(), hm);
    if (shiftH) snprintf(line, sizeof(line), "%s (%+dh)", hm, shiftH); else strlcpy(line, hm, sizeof(line));
    put(132, 5, line, shiftH ? AMB : TXT, 1, HEAD);
  } else put(132, 5, "sin hora", RED, 1, HEAD);
  put(214, 5, WiFi.status() == WL_CONNECTED ? "wifi" : "sin wifi", WiFi.status() == WL_CONNECTED ? GRN : RED, 1, HEAD);
  gfx->fillRoundRect(270, 2, 46, 14, 3, C(redMode ? 0xA000 : 0x3802));
  putCenter(293, 5, "ROJO", 0xFB6D, 1, redMode ? 0xA000 : 0x3802);
}
void drawTabs() {
  gfx->fillRect(0, 220, W, 20, C(HEAD));
  for (int i = 0; i < 6; i++) {
    int x = i * 53;
    if (i == tab) gfx->fillRoundRect(x + 1, 221, 52, 18, 3, C(BTN));
    putCenter(x + 27, 226, TABS[i], i == tab ? ACC : DIM, 1, i == tab ? BTN : HEAD);
  }
}
void drawTab() {
  if (tab == 0) { drawSky(); drawSkyPanel(); }
  else if (tab == 1) drawMoonTab();
  else if (tab == 2) drawNightTab();
  else if (tab == 3) drawAuroraTab();
  else if (tab == 4) drawLightTab();
  else drawPhotoTab();
}
void drawAll() { drawHeader(); drawTabs(); drawTab(); }

// ---------- Táctil (igual que Kilovatio MS) ----------
bool sampleRaw(int& x, int& y) {
  if (!touch.tirqTouched() || !touch.touched()) return false;
  TS_Point p = touch.getPoint();
  if (p.z < 250) return false;
  x = p.x; y = p.y;
  return true;
}
void toScreen(int rx, int ry, int& x, int& y) { x = lroundf(ax * rx + bx * ry + cx); y = lroundf(ay * rx + by * ry + cy); }
void calibrate() {
  const int sx[3] = {24, 296, 24}, sy[3] = {24, 24, 216};
  int rx[3], ry[3];
  while (true) {
    for (int i = 0; i < 3; i++) {
      gfx->fillScreen(BG);
      putCenter(160, 100, "CALIBRAR TÁCTIL", ACC, 2);
      putCenter(160, 128, "Toca el centro de la cruz", TXT);
      gfx->drawFastHLine(sx[i] - 10, sy[i], 21, AMB);
      gfx->drawFastVLine(sx[i], sy[i] - 10, 21, AMB);
      gfx->drawCircle(sx[i], sy[i], 8, AMB);
      int x, y;
      while (sampleRaw(x, y)) delay(10);
      int32_t sxr = 0, syr = 0;
      int n = 0;
      while (n < 12) {
        if (sampleRaw(x, y)) { sxr += x; syr += y; n++; }
        else { n = 0; sxr = syr = 0; }
        delay(12);
      }
      rx[i] = sxr / n; ry[i] = syr / n;
      while (sampleRaw(x, y)) delay(10);
      delay(150);
    }
    float ux = rx[1] - rx[0], uy = ry[1] - ry[0], vx = rx[2] - rx[0], vy = ry[2] - ry[0];
    float det = ux * vy - vx * uy;
    if (fabsf(det) < 10000) { putCenter(160, 160, "Repite las tres cruces", RED); delay(1000); continue; }
    ax = ((sx[1] - sx[0]) * vy - (sx[2] - sx[0]) * uy) / det;
    bx = (ux * (sx[2] - sx[0]) - vx * (sx[1] - sx[0])) / det;
    cx = sx[0] - ax * rx[0] - bx * ry[0];
    ay = ((sy[1] - sy[0]) * vy - (sy[2] - sy[0]) * uy) / det;
    by = (ux * (sy[2] - sy[0]) - vx * (sy[1] - sy[0])) / det;
    cy = sy[0] - ay * rx[0] - by * ry[0];
    prefs.putFloat("ax", ax); prefs.putFloat("bx", bx); prefs.putFloat("cx", cx);
    prefs.putFloat("ay", ay); prefs.putFloat("by", by); prefs.putFloat("cy", cy);
    prefs.putBool("cal", true);
    return;
  }
}
// Calibración guardada: la propia o la de otro proyecto MS con la misma rotación.
bool loadCalibration() {
  for (const char* ns : {"astrocyd", "radaravion", "kilovatio"}) {
    Preferences p;
    if (!p.begin(ns, true)) continue;
    bool ok = p.getBool("cal", false);
    if (ok) { ax = p.getFloat("ax"); bx = p.getFloat("bx"); cx = p.getFloat("cx"); ay = p.getFloat("ay"); by = p.getFloat("by"); cy = p.getFloat("cy"); }
    p.end();
    if (ok) return true;
  }
  return false;
}

// ---------- Portal de ajustes ----------
String htmlEscape(const String& s) {
  String o;
  for (char c : s) {
    if (c == '&') o += "&amp;"; else if (c == '<') o += "&lt;"; else if (c == '>') o += "&gt;";
    else if (c == '"') o += "&quot;"; else if (c == '\'') o += "&#39;"; else o += c;
  }
  return o;
}
const char PAGE_HEAD[] PROGMEM =
    "<!doctype html><html lang=es><meta charset=utf-8><meta name=viewport content='width=device-width,initial-scale=1'>"
    "<title>AstroCYD MS</title><style>body{font-family:system-ui,sans-serif;background:#05070f;color:#e8ecf5;"
    "max-width:420px;margin:auto;padding:20px}h1{font-size:22px}input,select,button{width:100%;box-sizing:border-box;"
    "padding:12px;margin:6px 0 14px;border-radius:10px;border:1px solid #2f5fb0;background:#0b1226;color:#fff;font-size:16px}"
    "button{background:#7fb8ff;color:#021;font-weight:700;border:0}small{color:#8a93a8}a{color:#7fb8ff}</style>";
void handleRoot() {
  String page = FPSTR(PAGE_HEAD);
  page += "<h1>AstroCYD MS · ajustes</h1><form method=post action=/save>"
          "<label>Wi-Fi de casa (2,4 GHz)</label><input name=s list=nets maxlength=32 placeholder='vacío = no cambiar'><datalist id=nets>";
  page += scannedOptions;
  page += "</datalist><label>Contraseña</label><input name=p type=password maxlength=63>"
          "<label>Ubicación</label><input name=loc maxlength=300 placeholder='40.4168, -3.7038 o enlace de Google Maps'>"
          "<small>Vacío = automática por internet (unos km de error). Para la exacta: en Google Maps mantén pulsado tu sitio "
          "y copia los números, o pulsa Compartir y pega el enlace. Se guarda solo en la placa y no sale en pantalla.</small>"
          "<label>Contaminación lumínica (escala Bortle)</label><select name=b>";
  for (int i = 1; i <= 9; i++) page += "<option value=" + String(i) + (i == bortle ? " selected>" : ">") + String(i) + " · " + BORTLE_NAMES[i] + "</option>";
  page += "</select><small>Mira tu zona en <a href='https://www.lightpollutionmap.info'>lightpollutionmap.info</a> "
          "(ábrelo con los datos del móvil): la capa VIIRS o World Atlas da la clase Bortle.</small>"
          "<button>Guardar</button></form><small>MS Robotika · AB MakerIDE · nubes de Open-Meteo, Kp de NOAA</small>";
  web.send(200, "text/html; charset=utf-8", page);
}
bool otherWifiSaved() {
  for (const char* ns : {"radaravion", "kilovatio"}) {
    Preferences k;
    if (!k.begin(ns, true)) continue;
    bool has = k.getString("ssid", "").length() > 0;
    k.end();
    if (has) return true;
  }
  return false;
}
void handleSave() {
  String s = web.arg("s"), p = web.arg("p"), loc = web.arg("loc");
  s.trim(); loc.trim();
  int b = web.arg("b").toInt();
  bool badWifi = s.length() > 32 || (s.length() && p.length() > 0 && (p.length() < 8 || p.length() > 63));
  bool noWifi = !s.length() && !prefs.isKey("ssid") && !otherWifiSaved();
  float la, lo;
  bool isCoords = loc.length() && !loc.startsWith("http") && parseLocation(loc, la, lo);
  bool isLink = loc.startsWith("https://") && (loc.indexOf("google.") > 0 || loc.indexOf("goo.gl") > 0);
  if (badWifi || noWifi || b < 1 || b > 9 || (loc.length() && !isCoords && !isLink)) {
    web.send(400, "text/html; charset=utf-8", String(FPSTR(PAGE_HEAD)) +
             "<h1>Revisa los datos</h1><p>Hace falta tu Wi-Fi (clave de 8 a 63 caracteres). La ubicación puede ir vacía, "
             "como 40.42, -3.70 o como enlace de Google Maps.</p><a href=/>Volver</a>");
    return;
  }
  if (s.length()) { prefs.putString("ssid", s); prefs.putString("pass", p); }
  prefs.putInt("bortle", b);
  if (isCoords) { prefs.putFloat("lat", la); prefs.putFloat("lon", lo); prefs.putString("src", "manual"); prefs.remove("link"); }
  else if (isLink) prefs.putString("link", loc);
  web.send(200, "text/html; charset=utf-8", String(FPSTR(PAGE_HEAD)) + "<h1>Guardado</h1><p>La placa se reinicia.</p>");
  Serial.println("MSR_ASTRO_SETTINGS_SAVED");
  delay(1200);
  ESP.restart();
}
static int qrX = 0, qrY = 0;
void drawQr(esp_qrcode_handle_t q) {
  int size = esp_qrcode_get_size(q), sc = max(1, 150 / (size + 4));
  gfx->fillRect(qrX, qrY, (size + 4) * sc, (size + 4) * sc, 0xFFFF);
  for (int y = 0; y < size; y++)
    for (int x = 0; x < size; x++)
      if (esp_qrcode_get_module(q, x, y)) gfx->fillRect(qrX + (x + 2) * sc, qrY + (y + 2) * sc, sc, sc, 0x0000);
}
void startPortal() {
  portalMode = true;
  shooting = false;
  redMode = false;
  analogWrite(PIN_BL, 255);
  WiFi.disconnect(true);
  WiFi.mode(WIFI_AP_STA);
  int n = WiFi.scanNetworks();
  scannedOptions = "";
  for (int i = 0; i < n && i < 15; i++) scannedOptions += "<option value=\"" + htmlEscape(WiFi.SSID(i)) + "\">";
  WiFi.scanDelete();
  char pass[9];
  snprintf(pass, sizeof(pass), "%08lu", (unsigned long)(esp_random() % 100000000UL));
  WiFi.softAP("AstroCYD-MS", pass);
  dns.start(53, "*", WiFi.softAPIP());
  web.on("/", HTTP_GET, handleRoot);
  web.on("/save", HTTP_POST, handleSave);
  web.onNotFound([] { web.sendHeader("Location", "http://192.168.4.1/"); web.send(302, "text/plain", ""); });
  web.begin();
  gfx->fillScreen(BG);
  gfx->fillRect(0, 0, W, 26, HEAD);
  put(10, 9, "ASTROCYD · AJUSTES DESDE EL MÓVIL", ACC, 1, HEAD);
  String qr = "WIFI:T:WPA;S:AstroCYD-MS;P:" + String(pass) + ";;";
  qrX = 8; qrY = 40;
  esp_qrcode_config_t cfg = ESP_QRCODE_CONFIG_DEFAULT();
  cfg.display_func = drawQr;
  cfg.max_qrcode_version = 6;
  esp_qrcode_generate(&cfg, qr.c_str());
  put(170, 44, "1. Escanea el QR", TXT);
  put(170, 58, "   con el móvil", TXT);
  put(170, 80, "2. Se abre la web;", TXT);
  put(170, 94, "   si no: 192.168.4.1", DIM);
  put(170, 116, "3. Wi-Fi, ubicación", TXT);
  put(170, 130, "   y tu cielo", TXT);
  put(170, 156, "Red: AstroCYD-MS", ACC);
  put(170, 170, "Clave:", ACC);
  put(212, 166, pass, AMB, 2);
  setLed(false, false, true);
  Serial.println("MSR_ASTRO_PORTAL ap=AstroCYD-MS");
}
bool connectWifi() {
  String s = prefs.getString("ssid", ""), p = prefs.getString("pass", "");
  for (const char* ns : {"radaravion", "kilovatio"}) {
    if (s.length()) break;
    Preferences k;
    if (k.begin(ns, true)) { s = k.getString("ssid", ""); p = k.getString("pass", ""); k.end(); }
  }
  if (!s.length()) return false;
  WiFi.mode(WIFI_STA);
  WiFi.setHostname("astrocyd-ms");
  WiFi.begin(s.c_str(), p.c_str());
  gfx->fillScreen(BG);
  putCenter(160, 96, "ASTROCYD", ACC, 3);
  putCenter(160, 132, "Conectando a la Wi-Fi...", TXT);
  for (int i = 0; i < 40 && WiFi.status() != WL_CONNECTED; i++) {
    gfx->fillCircle(130 + (i % 5) * 15, 160, 4, ACC);
    if (i % 5 == 4) gfx->fillRect(120, 154, 80, 12, BG);
    delay(500);
  }
  return WiFi.status() == WL_CONNECTED;
}

// ---------- Gestos ----------
bool touching = false, longFired = false;
int downX = 0, downY = 0;
uint32_t downAt = 0, upAt = 0;
void onTap(int x, int y) {
  if (y >= 220) {
    int t = constrain(x / 53, 0, 5);
    if (t != tab) {
      tab = t;
      if (tab == 5) startBle();
      if (tab == 4) previewBortle = 0;
      drawAll();
    }
    return;
  }
  if (y < 18) {
    if (x >= 266) { redMode = !redMode; analogWrite(PIN_BL, redMode ? 50 : 255); drawAll(); }
    else if (shiftH) { shiftH = 0; drawAll(); }
    return;
  }
  if (tab == 0) tapSky(x, y);
  else if (tab == 4 && y >= 200) {
    int b = previewBortle ? previewBortle : bortle;
    if (x < 135) b = max(1, b - 1); else if (x > 185) b = min(9, b + 1);
    previewBortle = b;
    drawLightTab();
  } else if (tab == 5) tapPhoto(x, y);
}
void handleTouch() {
  int rx, ry;
  uint32_t t = millis();
  if (sampleRaw(rx, ry)) {
    int x, y;
    toScreen(rx, ry, x, y);
    if (!touching) { touching = true; longFired = false; downX = x; downY = y; downAt = t; }
    upAt = t;
    if (!longFired && t - downAt > 3000) { longFired = true; startPortal(); }
    return;
  }
  if (touching && t - upAt > 60) {
    touching = false;
    if (!longFired && !portalMode) onTap(downX, downY);
  }
}

// ---------- Autoprueba con ejemplos del libro de Meeus ----------
bool near(double a, double b, double tol) { double d = fabs(a - b); if (d > 180) d = 360 - d; return d <= tol; }
bool selfTest() {
  bool ok = true;
  auto chk = [&](const char* what, double got, double want, double tol) {
    bool g = near(got, want, tol);
    Serial.printf("MSR_ASTRO_TEST %s got=%.4f want=%.4f %s\n", what, got, want, g ? "OK" : "FAIL");
    ok &= g;
  };
  astro::Eq s = astro::sun(astro::dayNumber(718934400));  // 13 oct 1992 (ej. 25.a)
  chk("sol_ra", s.ra, 198.38083, 0.05); chk("sol_dec", s.dec, -7.78507, 0.05);
  astro::MoonState m = astro::moon(astro::dayNumber(703036800));  // 12 abr 1992 (ej. 47.a)
  chk("luna_ra", m.eq.ra, 134.68847, 0.15); chk("luna_dec", m.eq.dec, 13.76837, 0.15);
  chk("luna_km", m.eq.dist * 6378.14, 368409.7, 1500);
  astro::Planet v = astro::planet(1, astro::dayNumber(724809600));  // Venus 20 dic 1992 (ej. 33.a)
  chk("venus_ra", v.eq.ra, 316.17273, 0.05); chk("venus_dec", v.eq.dec, -18.88801, 0.05);
  chk("gmst", astro::gmst(astro::dayNumber(545011200)), 197.693195, 0.05);  // 10 abr 1987 (ej. 12.a)
  double lst = astro::rev(astro::gmst(astro::dayNumber(545080860)) - 77.06556);  // Washington (ej. 13.b)
  astro::Hor h = astro::toHorizon(347.3193375, -6.719892, lst, 38.92139);
  chk("alt", h.alt, 15.1249, 0.1); chk("az", h.az, 248.0337, 0.1);
  float la = 0, lo = 0;
  bool p1 = parseLocation("40.4168, -3.7038", la, lo) && near(la, 40.4168, 1e-3) && near(lo, -3.7038, 1e-3);
  bool p2 = parseLocation("https://www.google.com/maps/place/Sol/@40.4169473,-3.7035285,17z/data=!3m1!4b1!4m6!3m5!1s0x0:0x0!8m2!3d40.4167754!4d-3.7037902", la, lo) && near(la, 40.41678, 1e-4);
  bool p3 = parseLocation("https://maps.google.com/?q=42.2167%2C-2.1", la, lo) && near(lo, -2.1, 1e-3);
  bool p4 = !parseLocation("https://maps.app.goo.gl/abcDEF123", la, lo);
  Serial.printf("MSR_ASTRO_TEST ubicacion %d%d%d%d %s\n", p1, p2, p3, p4, p1 && p2 && p3 && p4 ? "OK" : "FAIL");
  return ok && p1 && p2 && p3 && p4;
}

// ---------- Programa ----------
uint32_t lastSky = 0, lastClock = 0;
void setup() {
  Serial.begin(115200);
  delay(200);
  Serial.printf("MSR_ASTRO_BOOT selftest=%s stars=%d\n", selfTest() ? "OK" : "FAIL", STAR_COUNT);
  pinMode(LED_R, OUTPUT); pinMode(LED_G, OUTPUT); pinMode(LED_B, OUTPUT);
  setLed(false, false, false);
  pinMode(5, OUTPUT);
  digitalWrite(5, HIGH);  // microSD sin usar
  pinMode(PIN_BL, OUTPUT);
  analogWrite(PIN_BL, 255);
  lcdBus.begin(14, 12, 13, 15);
  lcd.begin(40000000);
  lcd.setRotation(1);
  lcd.cp437(true);
  touchBus.begin(25, 39, 32, 33);
  touch.begin(touchBus);
  touch.setRotation(1);

  prefs.begin("astrocyd", false);
  bortle = constrain(prefs.getInt("bortle", 5), 1, 9);
  if (prefs.isKey("lat")) {
    homeLat = prefs.getFloat("lat", homeLat); homeLon = prefs.getFloat("lon", homeLon);
    strlcpy(locSource, prefs.getString("src", "manual").c_str(), sizeof(locSource));
  } else {
    Preferences r;  // la ubicación de Radar Aviones MS, si la hay
    if (r.begin("radaravion", true)) {
      if (r.isKey("lat")) { homeLat = r.getFloat("lat", homeLat); homeLon = r.getFloat("lon", homeLon); strlcpy(locSource, "radar", sizeof(locSource)); }
      r.end();
    }
  }
  if (!loadCalibration()) calibrate();
  if (!connectWifi()) { startPortal(); return; }
  Serial.printf("MSR_ASTRO_WIFI_OK rssi=%ld\n", WiFi.RSSI());
  configTime(0, 0, "pool.ntp.org", "time.google.com");
  gfx->fillScreen(BG);
  putCenter(160, 110, "Poniendo en hora...", TXT);
  for (int i = 0; i < 40 && time(nullptr) < 1700000000; i++) delay(250);
  timeOk = time(nullptr) > 1700000000;
  String link = prefs.getString("link", "");
  if (link.length()) resolveMapsLink(link);
  if (!strcmp(locSource, "defecto")) ipLocate();
  Serial.printf("MSR_ASTRO_LOCATION src=%s\n", locSource);  // nunca se imprimen las coordenadas
  if (fetchWeather()) weatherAt = millis();
  if (fetchKp()) kpAt = millis();
  drawAll();
  lastSky = lastClock = millis();
}

// Órdenes por USB para probar y sacar capturas sin tocar la pantalla:
// MSR_TAB n · MSR_TAP x y · MSR_RED · MSR_SHIFT h · MSR_SHOT (manda la pantalla en RGB565).
// Lienzo de una franja de la pantalla: una captura entera (150 KB) no cabe en la RAM libre.
class Strip : public Adafruit_GFX {
 public:
  uint16_t buf[W * 48];
  int y0 = 0;
  Strip() : Adafruit_GFX(W, H) {}
  void drawPixel(int16_t x, int16_t y, uint16_t c) override {
    y -= y0;
    if (x >= 0 && x < W && y >= 0 && y < 48) buf[y * W + x] = c;
  }
};
void sendScreenshot() {
  Strip* st = new (std::nothrow) Strip();
  if (!st) { Serial.printf("MSR_SHOT_ERROR heap=%u\n", (unsigned)ESP.getFreeHeap()); return; }
  st->cp437(true);
  Serial.printf("MSR_SHOT_BEGIN %d %d\n", W, H);
  for (st->y0 = 0; st->y0 < H; st->y0 += 48) {
    memset(st->buf, 0, sizeof(st->buf));
    gfx = st;
    drawAll();
    gfx = &lcd;
    Serial.write((const uint8_t*)st->buf, sizeof(st->buf));  // little-endian, fila a fila
  }
  Serial.println();
  Serial.println("MSR_SHOT_END");
  delete st;
}
void pollSerial() {
  static char buf[40];
  static uint8_t len = 0;
  while (Serial.available()) {
    char c = Serial.read();
    if (c != '\n' && c != '\r') { if (len < sizeof(buf) - 1) buf[len++] = c; continue; }
    buf[len] = 0;
    len = 0;
    int a, b;
    if (sscanf(buf, "MSR_TAB %d", &a) == 1) { tab = constrain(a, 0, 5); if (tab == 5) startBle(); drawAll(); }
    else if (sscanf(buf, "MSR_TAP %d %d", &a, &b) == 2) onTap(a, b);
    else if (!strcmp(buf, "MSR_RED")) onTap(300, 8);
    else if (sscanf(buf, "MSR_SHIFT %d", &a) == 1) { shiftH = constrain(a, -12, 12); drawAll(); }
    else if (!strcmp(buf, "MSR_SHOT")) sendScreenshot();
    else continue;
    Serial.printf("MSR_CMD_OK %s\n", buf);
  }
}

void loop() {
  if (portalMode) { dns.processNextRequest(); web.handleClient(); delay(2); return; }
  pollSerial();
  handleTouch();
  uint32_t ms = millis();
  if (shooting && ms >= nextShotAt) {
    if (shutter()) { shots++; Serial.printf("MSR_ASTRO_SHOT n=%d\n", shots); }
    nextShotAt = ms + ivSec * 1000UL;
    if (ivCount && shots >= ivCount) { shooting = false; Serial.println("MSR_ASTRO_INTERVAL DONE"); }
    if (tab == 5) drawPhotoTab();
  }
  if (bleDirty) { bleDirty = false; if (tab == 5) drawPhotoTab(); }
  if (ms - weatherAt > 30 * 60000UL && WiFi.status() == WL_CONNECTED && !shooting) {
    weatherAt = ms;  // un fallo espera al siguiente ciclo, no reintenta en bucle
    fetchWeather();
    if (fetchKp()) kpAt = millis();
    if (tab == 2 || tab == 3) drawTab();
  }
  if (!timeOk && time(nullptr) > 1700000000) { timeOk = true; drawAll(); }
  if (ms - lastClock > 10000) {
    lastClock = ms;
    drawHeader();
    float kp = kpNow();
    bool alert = kp >= 0 && kp >= astro::kpNeeded(fabsf(astro::geomagLat(homeLat, homeLon)));
    setLed(alert, false, false);
    if (tab == 5 && shooting) drawPhotoTab();
  }
  if (tab == 0 && ms - lastSky > 30000 && !touching) { lastSky = ms; drawSky(); drawSkyPanel(); }
  delay(2);
}
